#include <Adafruit_SSD1306.h>
#include <SoftwareSerial.h>

#define nombreDePixelsEnLargeur 128         // Taille de l'écran OLED, en pixel, au niveau de sa largeur
#define nombreDePixelsEnHauteur 32          // Taille de l'écran OLED, en pixel, au niveau de sa hauteur
#define brocheResetOLED         -1          // Reset de l'OLED partagé avec l'Arduino (d'où la valeur à -1, et non un numéro de pin)
#define adresseI2CecranOLED     0x3C        // Adresse de "mon" écran OLED sur le bus i2c (généralement égal à 0x3C ou 0x3D)

#define rxPin 7                             // Broche 7 en tant que RX, à raccorder sur RX du HC-05
#define txPin 6                             // Broche 6 en tant que TX, à raccorder sur TX du HC-05

#define pinSW 2
#define pinCLK 3
#define pinDT 4
#define MENU_SIZE 4
  
SoftwareSerial BTserial(rxPin, txPin);      // Définition du software serial

Adafruit_SSD1306 ecranOLED(nombreDePixelsEnLargeur, nombreDePixelsEnHauteur, &Wire, brocheResetOLED);

// ----------------------------
// CAPTEUR --------------------
// ----------------------------
float VADC = 0.0;
float VCC = 5.0;
float R1 = 100000.0;
float R2 = 390.0;
float R3 = 100000.0;
float R5 = 10000.0;
float RS = 0.0;

int analogPin = A0;

// ----------------------------
// ENCODEUR ROTATOIRE ---------
// ----------------------------
// Rotary Encoder Module connections
const int PinSW = 2;   // Rotary Encoder Switch
const int PinDT = 4;    // DATA signal
const int PinCLK = 3;    // CLOCK signal

// Variables to debounce Rotary Encoder
long TimeOfLastDebounce = 0;
int DelayofDebounce = 100;

unsigned long myTime;     // For timer panel

int count1 = 0;           // Count for main_panel
int lastCount1 = 0;

int count2 = 0;           // Count for calibre_panel
int lastCount2 = 0;

long TimeOfLastDebounceSwitch = 0; // Variables to debounce Rotary Encoder Switch button 
int DelayofDebounceSwitch = 500;

bool switch_button = false;
bool prev_switch_button = false;

float calibre = 1.0;

// 'Logo_Grand_Potentiel', 128x64px
const unsigned char myBitmap [] PROGMEM = {
  0xff, 0xff, 0xff, 0xff, 0x00, 0x00, 0x00, 0x00, 0x07, 0xff, 0xff, 0xff, 0xff, 0xff, 0xff, 0xff, 
  0xff, 0xff, 0xff, 0xff, 0x00, 0x00, 0x00, 0x00, 0x07, 0xff, 0xff, 0xff, 0xff, 0xff, 0xff, 0xff, 
  0xff, 0xff, 0xff, 0xff, 0x00, 0x00, 0x00, 0x00, 0x07, 0xff, 0xff, 0xff, 0xff, 0xff, 0xff, 0xff, 
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  0xff, 0xff, 0xff, 0xff, 0x00, 0x00, 0x00, 0x00, 0x07, 0xff, 0xff, 0xff, 0xff, 0xff, 0xff, 0xff
};

void switched() {  // Changes boolean value if switch button is pushed or not
  if ((millis() - TimeOfLastDebounceSwitch) > DelayofDebounceSwitch) {
    if (switch_button){
      switch_button = false;
    }
    else {
      switch_button = true;
    }
  }
  TimeOfLastDebounceSwitch = millis();
}

void doEncoder() {  // Make the rotation counter to select the menus
  
  if ((millis() - TimeOfLastDebounce) > DelayofDebounce) {  // debouncing
    if (digitalRead(pinDT) == digitalRead(pinCLK)) {
      if (!switch_button){
        count1--;
        if (lastCount1 == 0) {
            count1 = 3;
        }
      }
      else if (switch_button){
        count2--;
      if (lastCount2 == 0) {
          count2 = 2;
        }
      }
    }
    else if (digitalRead(pinDT) != digitalRead(pinCLK)) {
      if (!switch_button) {
        count1++;
        if (lastCount1 == 3) {
            count1 = 0;
        }
      }
      else if (switch_button){
        count2++;
        if (lastCount2 == 2) {
          count2 = 0;
        }
      }
    }
  }
  lastCount1 = count1;
  lastCount2 = count2;
  TimeOfLastDebounce = millis();  // Set variable to current millis() timer
  Serial.println(count1);
}


void main_panel() {  // displays everything on the OLED
  ecranOLED.clearDisplay();
  ecranOLED.setCursor(0,1);
  
  const char *options[4] = {
    " Resistance & Voltage",
    " Calibre",
    " Timer",
    " GP"
  };

  if (!switch_button) {     // main menu
    for (int i = 0; i < 5; i++) {
      if (i == count1) {
        ecranOLED.setTextColor(SSD1306_BLACK, SSD1306_WHITE);
        ecranOLED.println(options[i]);
      } else if (i != count1) {  
        ecranOLED.setTextColor(SSD1306_WHITE);
        ecranOLED.println(options[i]);
      }
    }
  }
  else if (switch_button) {   // sub-menus
    ecranOLED.drawRect(0, 0, 128,32, WHITE);
    
    if (count1 == 0) {        // Resistance & voltage sub-menu
      ecranOLED.setCursor(0, 2);
      ecranOLED.println(" Resistance :");
      ecranOLED.print(" ");
      ecranOLED.print(RS);
      if (count2 == 0) {
        calibre = 1;
        ecranOLED.println(" ohm");
      }
      else if (count2 == 1) {
        calibre = 0.001;
        ecranOLED.println(" kohm");
      }
      else if (count2 == 2) {
        calibre = 0.000001;
        ecranOLED.println(" Mohm");
      }
      ecranOLED.setCursor(0, 21);
      ecranOLED.print(" Voltage :  ");
      ecranOLED.setTextSize(1);
      ecranOLED.print(VADC);
      ecranOLED.print(" V");
    }
    
    else if (count1 == 1) {   // calibre sub-menu
      calibre_panel();
    }
    
    else if (count1 == 2) {   // timer sub-menu
      ecranOLED.setCursor(0, 2);
      ecranOLED.println(" Time since program");
      ecranOLED.println(" started :");
      ecranOLED.setCursor(30, 21);
      ecranOLED.print(myTime);
      ecranOLED.println(" seconds");
    }
    
    else if (count1 == 3) {   // image sub-menu
      ecranOLED.clearDisplay();
      ecranOLED.drawBitmap(0, 0, myBitmap, 128, 64, WHITE); // display.drawBitmap(x position, y position, bitmap data, bitmap width, bitmap height, color)
    }
  }

  
  ecranOLED.display();
}

void calibre_panel() {    // allows to select a calibre for resistance value
  ecranOLED.setCursor(0, 4);
  const char *options_calibre[3] = {
    "    ohm",
    "  k ohm",
    "  M ohm"
  };
  for (int i = 0; i < 3; i++) {
    if (i == count2) {
      ecranOLED.setTextColor(SSD1306_BLACK, SSD1306_WHITE);
      ecranOLED.println(options_calibre[i]);
    } else if (i != count2) {  
      ecranOLED.setTextColor(SSD1306_WHITE);
      ecranOLED.println(options_calibre[i]);
    }
  }
  ecranOLED.setCursor(100, 23);
  ecranOLED.print("HBKT");
}


// --------------------------------------------------------------------------------------------
// SETUP --------------------------------------------------------------------------------------
// --------------------------------------------------------------------------------------------

void setup() {
  Serial.begin(9600);
  BTserial.begin(9600);
  
  pinMode(A0, INPUT); // pin pour entrée analogique, mesure de tension VADC

  ecranOLED.begin(SSD1306_SWITCHCAPVCC, adresseI2CecranOLED);
  ecranOLED.clearDisplay();                 // Effaçage de l'intégralité du buffer
  ecranOLED.setTextSize(1);                 // Taille des caractères 
  ecranOLED.setCursor(0, 0);                // Déplacement du curseur en postion (0,0)
  ecranOLED.setTextColor(SSD1306_WHITE);


  pinMode(rxPin, INPUT);        // pin for bluetooth module
  pinMode(txPin, OUTPUT);       // pin for bluetooth module

  pinMode(pinCLK, INPUT);
  pinMode(pinDT, INPUT);
  pinMode(pinSW, INPUT_PULLUP); // Set the Switch pin to use Arduino PULLUP resistors

  attachInterrupt(digitalPinToInterrupt(pinCLK), doEncoder, CHANGE);    // attach interrupt for rotation movement
  attachInterrupt(digitalPinToInterrupt(pinSW), switched, CHANGE);      // attach interrupt for switch button
}



// --------------------------------------------------------------------------------------------
// LOOP ---------------------------------------------------------------------------------------
// --------------------------------------------------------------------------------------------

void loop() {
  VADC = analogRead(analogPin)*0.004882814;     // sensor voltage read by the arduino 
  
  RS = ( ((1 + R3/R2)*R1*(VCC/VADC)) - R1 - R5) * calibre;  // sensor resistance
  
  main_panel();
  
  myTime = millis() / 1000;            
  
  prev_switch_button = switch_button;
  
  byte VADC1 = map(analogRead(analogPin), 0, 1024, 0, 255); //Encodage de la tension VADC sur un byte
  BTserial.write(VADC1); // Envoie de la donnée de tension sur un byte
  delay(100);
}
